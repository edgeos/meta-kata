## meta-kata-qemu/conf/layer.conf
```bitbake
# We have a conf and classes directory, add to BBPATH
BBPATH .= ":${LAYERDIR}"

# We have recipes-* directories, add to BBFILES
BBFILES += "${LAYERDIR}/recipes-*/*/*.bb \
            ${LAYERDIR}/recipes-*/*/*.bbappend"

BBFILE_COLLECTIONS += "katacontainers"
BBFILE_PATTERN_katacontainers = "^${LAYERDIR}/"
BBFILE_PRIORITY_katacontainers = "71"

PREFERRED_VERSION_dpdk ?= "17.11.1"

#Remove some warnings in newer versions of bitbake
LAYERSERIES_COMPAT_katacontainers = "pyro rocko sumo"
```
